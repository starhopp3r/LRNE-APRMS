// Done by Bryan Tee Pak Hong for Team SudoX

#include <MCUFRIEND_kbv.h>
#include <Adafruit_GFX.h>    // Core graphics library
#include <avr/pgmspace.h>
#include <SoftwareSerial.h>
#include <TinyGPS.h>

//========================================================
// Reference for  SudoX
//========================================================
// wiring with ATMega328P-PU: //--------------POWER Pins-------------------------------- //   5V  connects to DC 5V
//   GND connects to Ground
//--------------LCD Display Pins--------------------------
//   LCD_RD     connects to Analog pin A0
//   LCD_WR     connects to Analog pin A1
//   LCD_RS     connects to Analog pin A2
//   LCD_CS     connects to Analog pin A3
//   LCD_RST    connects to Analog pin A4
//   LCD_D0     connects to digital pin 8
//   LCD_D1     connects to digital pin 9
//   LCD_D2     connects to digital pin 2
//   LCD_D3     connects to digital pin 3
//   LCD_D4     connects to digital pin 4
//   LCD_D5     connects to digital pin 5
//   LCD_D6     connects to digital pin 6
//   LCD_D7     connects to digital pin 7
//   GPS TX     connects to digital pin 13
//   GPS RX     connects to digital pin 12
//   LR buttons connects to Analog pin A5
//   CONFIRM    connects to digital pin 11
//==========================================================

// These are important pins (for TFT LCD screen)
//----------------------------------------------------------
#define LCD_RESET A4
#define LCD_CS A3
#define LCD_CD A2
#define LCD_WR A1
#define LCD_RD A0
//Pins 2-9 are also occupied by LCD screen
//----------------------------------------------------------

// Assign human-readable names to some common 16-bit color values:
#define BLACK   0x0000
#define BLUE    0x001F
#define RED     0xF800
#define GREEN   0x03E0
#define CYAN    0x07FF
#define MAGENTA 0xF81F
#define YELLOW  0xFFE0
#define WHITE   0xFFFF
#define ORANGE  0xF980

// Defining input buttons for selection:
#define BUTTON A5
#define CONFIRM 11 

// Defining other constants
#define TRANSMIT_TIME 5000 // in ms
#define IDLE_TIME 30000 // in ms
#define ON 0 // default on state

// Defining device ID
#define DEVICE_ID 0

// 'medical', 70x70px
const unsigned char medical [] PROGMEM = {
  0x00, 0x00, 0x00, 0x07, 0xff, 0x80, 0x00, 0x00, 0x00, 0x00, 0x00, 0x00, 0x7f, 0xff, 0xf8, 0x00, 
  0x00, 0x00, 0x00, 0x00, 0x03, 0xff, 0xff, 0xff, 0x00, 0x00, 0x00, 0x00, 0x00, 0x0f, 0xff, 0xff, 
  0xff, 0xc0, 0x00, 0x00, 0x00, 0x00, 0x3f, 0xff, 0x8f, 0xff, 0xf0, 0x00, 0x00, 0x00, 0x00, 0xff, 
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  0x07, 0xff, 0x80, 0x00, 0x00, 0x00
};
// 'ration', 70x70px
const unsigned char ration [] PROGMEM = {
  0x00, 0x00, 0x00, 0x07, 0xff, 0x80, 0x00, 0x00, 0x00, 0x00, 0x00, 0x00, 0x7f, 0xff, 0xf8, 0x00, 
  0x00, 0x00, 0x00, 0x00, 0x03, 0xff, 0xff, 0xff, 0x00, 0x00, 0x00, 0x00, 0x00, 0x0f, 0xff, 0xff, 
  0xff, 0xc0, 0x00, 0x00, 0x00, 0x00, 0x3f, 0xff, 0xff, 0xff, 0xf0, 0x00, 0x00, 0x00, 0x00, 0xff, 
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  0x07, 0xff, 0x80, 0x00, 0x00, 0x00
};
// 'shelter', 70x70px
const unsigned char shelter [] PROGMEM = {
  0x00, 0x00, 0x00, 0x07, 0xff, 0x80, 0x00, 0x00, 0x00, 0x00, 0x00, 0x00, 0x7f, 0xff, 0xf8, 0x00, 
  0x00, 0x00, 0x00, 0x00, 0x03, 0xff, 0xff, 0xff, 0x00, 0x00, 0x00, 0x00, 0x00, 0x0f, 0xff, 0xff, 
  0xff, 0xc0, 0x00, 0x00, 0x00, 0x00, 0x3f, 0xff, 0xff, 0xff, 0xf0, 0x00, 0x00, 0x00, 0x00, 0xff, 
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  0x07, 0xff, 0x80, 0x00, 0x00, 0x00
};

// 'transSq', 74x74px
const unsigned char transSq [] PROGMEM = {
  0xff, 0xfe, 0x00, 0x00, 0x00, 0x00, 0x00, 0x1f, 0xff, 0xc0, 0xff, 0xfc, 0x00, 0x00, 0x00, 0x00, 
  0x00, 0x0f, 0xff, 0xc0, 0xff, 0xf8, 0x00, 0x00, 0x00, 0x00, 0x00, 0x07, 0xff, 0xc0, 0xff, 0xf0, 
  0x00, 0x00, 0x00, 0x00, 0x00, 0x03, 0xff, 0xc0, 0xff, 0xe0, 0x00, 0x00, 0x00, 0x00, 0x00, 0x01, 
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  0x00, 0x1f, 0xff, 0xc0

};

// 'Double Tick', 60x60px
const unsigned char double_tick [] PROGMEM = {
  0x00, 0x00, 0x00, 0x00, 0x00, 0x00, 0x00, 0x00, 0x00, 0x00, 0x00, 0x00, 0x00, 0x00, 0x00, 0x00, 
  0x00, 0x00, 0x00, 0x00, 0x00, 0x00, 0x00, 0x00, 0x00, 0x00, 0x00, 0x00, 0x00, 0x00, 0x00, 0x00, 
  0x00, 0x00, 0x00, 0x00, 0x00, 0x00, 0x00, 0x00, 0x00, 0x00, 0x00, 0x00, 0x00, 0x00, 0x00, 0x00, 
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  0x00, 0x00, 0x00, 0x00, 0x00, 0x00, 0x00, 0x00, 0x00, 0x00, 0x00, 0x00, 0x00, 0x00, 0x00, 0x00
};

// 'Ellipsis', 60x60px
const unsigned char ellipsis [] PROGMEM = {
  0x00, 0x00, 0x00, 0x00, 0x00, 0x00, 0x00, 0x00, 0x00, 0x00, 0x00, 0x00, 0x00, 0x00, 0x00, 0x00, 
  0x00, 0x00, 0x00, 0x00, 0x00, 0x00, 0x00, 0x00, 0x00, 0x00, 0x00, 0x00, 0x00, 0x00, 0x00, 0x00, 
  0x00, 0x00, 0x00, 0x00, 0x00, 0x00, 0x00, 0x00, 0x00, 0x00, 0x00, 0x00, 0x00, 0x00, 0x00, 0x00, 
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  0x00, 0x00, 0x00, 0x00, 0x00, 0x00, 0x00, 0x00, 0x00, 0x00, 0x00, 0x00, 0x00, 0x00, 0x00, 0x00
};

//==============================================================================================
//Prototype functions
//==============================================================================================
void normalDisplay(void);
void optionSelectionUI(void);
void gpsGetCoordinates(void);
String encodeMessage(String);
String parseMessage(String, byte);
// Some functions for optionSelectUI
void selectShelter(int);
void deselectShelter(void);
void selectRation(int);
void deselectRation(void);
void selectMedical(int);
void deselectMedical(void);
void callLopy(unsigned long wakeTime);
void readLopy(void);
//==============================================================================================

//==============================================================================================
// Global variables
//==============================================================================================

MCUFRIEND_kbv tft;
byte Message = 11, c_Message = 11;
String broadcastMessage = "", requestStatus = "";
SoftwareSerial gpsSerial (13, 12); //13 to GPS TX, 12 tp GPS RX
TinyGPS gps;
String msgStatus = "0";
float flat = 1.3099;
float flon = 103.7775;
unsigned long fix_age = 1, time = 1, date = 1; // returns +- latitude/longitude in degrees
unsigned long screenOn = millis();
char* temp;
char c;
int i = 0;
//==============================================================================================

void setup() {
  gpsSerial.begin(9600);
  Serial.begin(9600);
  tft.reset();
  uint16_t identifier = tft.readID();
  tft.begin(identifier);
  tft.fillScreen(BLACK);
  tft.setRotation(1);
  tft.setCursor(5, 25);
  tft.setTextColor(WHITE);
  tft.setTextSize(4);
  // Write HELP IS HERE!
  tft.println("HELP IS HERE!");
  normalDisplay();
  temp = new char[64];

  //Listening to LoPy, code here must change!
  // first edits done on 30/12/2018
  // second edits done on 31/12/2018 ==> changed software serial lopy to hardware serial
  Serial.write("OK");
  while (((c = Serial.read()) != '#'));
  temp[Serial.readBytesUntil('#', temp, 64)] = '\0';
  
  Message = parseMessage(temp, 0).toInt();
  broadcastMessage = parseMessage(temp, 1);
  requestStatus = parseMessage(temp, 2);

  // handle request
  if (requestStatus == "P") clear_status();
  else if (requestStatus == "I") draw_ellipsis();
  else draw_double_tick();

  draw_broadcast();
  
  delete temp;
  
  pinMode(BUTTON, INPUT); // reading different voltage levels as left and right
  pinMode(CONFIRM, INPUT); // sending this message to lopy
  tft.setTextSize(2);


  if (Message == 0) {
    selectShelter(WHITE);
  }
  else if (Message == 1) {
    selectRation(WHITE);
  }
  else if (Message == 2) {
    selectMedical(WHITE);
  }
}

// xiao mod
unsigned long long last_time = millis();

void loop() {
  if (millis() - last_time >= 15000) {
    gpsGetCoordinates();
    screenOn = (millis() - screenOn) / IDLE_TIME;
    callLopy();
    readLopy();
    last_time = millis();
  }
  optionSelectionUI();
}

void normalDisplay() {
  // We draw 3 circles horizontal in the screen with the icons
  // size R = 31, distance betwen each circle is 33
  // Width: 320, Height: 240
  
  // 1st circle(shelter)
  tft.fillRoundRect(26, tft.height() / 2 - 50, 72, 72, 36, BLUE);
  tft.drawBitmap(27, tft.height() / 2 - 50 , shelter, 70, 70, WHITE);
  
  //2nd circle(ration)
  tft.fillRoundRect(98 + 26, tft.height() / 2 - 50, 72, 72, 36, GREEN);
  tft.drawBitmap(98 + 27, tft.height() / 2 - 50 , ration, 70, 70, WHITE);
  
  //3rd round circle(medical)
  tft.fillRoundRect(196 + 26, tft.height() / 2 - 50, 72, 72, 36, RED);
  tft.drawBitmap(196 + 27, tft.height() / 2 - 50 , medical, 70, 70, WHITE);
}

int signal_quality = 0;
#define MIN_QUALITY 4
void optionSelectionUI() {

  // left right scrolling
  if (analogRead(BUTTON) < 1000) {
    screenOn = millis(); // reset time to sleep
    if (analogRead(BUTTON) > 500) {
      if (signal_quality > 0) signal_quality = 0;
      if (--signal_quality <= -MIN_QUALITY) {
        tft.setCursor(90, 180);
        if (Message == 0) {
          deselectShelter();
          selectRation(WHITE);
          Message = 1;
        } else if (Message == 1) {
          deselectRation();
          selectMedical(WHITE);
          Message = 2;
        } else if (Message == 2) {
          deselectMedical();
          selectShelter(WHITE);
          Message = 0;
        }
        signal_quality = 0;
      }
    } else if (analogRead(BUTTON) <= 500) {
      if (signal_quality < 0) signal_quality = 0;
      if (++signal_quality >= MIN_QUALITY) {
        if (Message == 0) {
          deselectShelter();
          selectMedical(WHITE);
          Message = 2;
        } else if (Message == 2) {
          deselectMedical();
          selectRation(WHITE);
          Message = 1;
        } else if (Message == 1) {
          deselectRation();
          selectShelter(WHITE);
          Message = 0;
        }
        signal_quality = 0;
      }
    }
  } else if (!digitalRead(CONFIRM)) {
    screenOn = millis(); // reset sleep time
    c_Message = Message;
    requestStatus = "P";
  }
}

void selectShelter(int color) {
  tft.drawBitmap(26, tft.height() / 2 - 52 , transSq, 74, 74, color);
}

void deselectShelter() {
  tft.drawBitmap(26, tft.height() / 2 - 52 , transSq, 74, 74, BLACK);
}

void selectRation(int color) {
  tft.drawBitmap(123, tft.height() / 2 - 52 , transSq, 74, 74, color);
}

void deselectRation() {
  tft.drawBitmap(123, tft.height() / 2 - 52 , transSq, 74, 74, BLACK);
}

void selectMedical(int color) {
  tft.drawBitmap(221, tft.height() / 2 - 52  , transSq, 74, 74, color);
}

void deselectMedical() {
  tft.drawBitmap(221, tft.height() / 2 - 52  , transSq, 74, 74, BLACK);
}

void clear_status() {
  tft.fillRect(0, tft.height() / 2 + 30, tft.width(), 60, BLACK);
}

void draw_broadcast() {
  tft.fillRect(0, tft.height() / 2 + 95, tft.width(), 10, BLACK);
  tft.setCursor(26 + 4, tft.height() / 2 + 95);
  tft.setTextSize(1.5);
  tft.print(broadcastMessage);
}

void draw_double_tick() {
  clear_status();
  tft.drawBitmap(26 + 4, tft.height() / 2 + 30, double_tick, 60, 60, BLUE);
}

void draw_ellipsis() {
  clear_status();
  tft.drawBitmap(26 + 4, tft.height() / 2 + 30, ellipsis, 60, 60, GREEN);
}

void gpsGetCoordinates() {
  // only gives accurate dates if gpsSerial is available
  if (gpsSerial.available()) {
    gps.f_get_position(&flat, &flon, &fix_age);
    gps.get_datetime(&date, &time, &fix_age);
  }
}

void callLopy() {
  Serial.print(encodeMessage());
}

void readLopy() {
  temp = new char[64];
  while ((c = Serial.read()) != '#' && i++ < 100) delay(10);
  
  if (i <= 100) {
    temp[Serial.readBytesUntil('#', temp, 64)] = '\0';
    c_Message = parseMessage(temp, 0).toInt();
    broadcastMessage = parseMessage(temp, 1);
    requestStatus = parseMessage(temp, 2); // remember to save P I C as strings!

    // handle request
    if (requestStatus == "P") clear_status();
    else if (requestStatus == "I") draw_ellipsis();
    else {
      draw_double_tick();
      c_Message = 11; //reset messsage
    }

    draw_broadcast();
  }

  i = 0;
  delete temp;
  delay(100);
}

// Format of the string from lopy to Arduino is
/*
   "Selection,broadcast,status"(this is what the arduino sees)
   "Device ID, dd/mm/yy hh:mm,latitude, longitude, resource, screenOn
*/

String encodeMessage() {
  // "Device ID, dd/mm/yy hh:mm,latitude, longitude, resourceid, screenUp
  String buffer = "#" + String(DEVICE_ID) + "," + encodeDate() + " " + String(encodeTime()) + "," + String(flat) + "," + String(flon) + "," + String(c_Message) + "," + String(screenOn) + "#";
  return buffer;
}

String encodeDate() {
  int day = date / 10000;
  int month = (date/ 100) - day * 100;
  int year = date - month * 100 - day * 10000;

  return ((day > 9) ? (String(day)) : (String('0') + day)) + "/" + ((month > 9) ? (String(month)) : (String('0') + month)) + "/" + ((year > 9) ? (String(year)) : (String('0') + year));
}

String encodeTime() {
  int hour = time / 1000000;
  int minute = (time / 10000) % 100;

  return ((hour > 9) ? (String(hour)) : (String('0') + hour)) + ":" + ((minute > 9) ? (String(minute)) : (String('0') + minute));
}

String parseMessage(String rawMessage, byte index) {
  // "Selection,broadcast,status"
  byte commaNum = 0, startNum = 0;
  String buffer;
  if ( index != 2) {
    for (int i = 0; i < index + 1; i++) {
      commaNum = rawMessage.indexOf(",", startNum);
      buffer = rawMessage.substring(startNum, commaNum);
      startNum = commaNum + 1;
    }
  }
  else {
    for (int i = 0; i < 2; i++) {
      commaNum = rawMessage.indexOf(",", startNum);
      buffer = rawMessage.substring(startNum, commaNum);
      startNum = commaNum + 1;
    }
    buffer = rawMessage.charAt(startNum);
  }
  return buffer;
}
