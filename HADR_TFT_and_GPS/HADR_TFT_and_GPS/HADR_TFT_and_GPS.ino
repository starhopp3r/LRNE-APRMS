// Done by Bryan Tee Pak Hong for Team SudoX

#include <MCUFRIEND_kbv.h>
#include <Adafruit_GFX.h>    // Core graphics library
#include <avr/pgmspace.h>
#include <SoftwareSerial.h>
#include <TinyGPS.h>

//========================================================
// Reference for  SudoX
//========================================================
// wiring with UNO:
//--------------POWER Pins--------------------------------
//   5V  connects to DC 5V
//   GND connects to Ground
//   3V3 do not need to connect(NC)
//--------------LCD Display Pins--------------------------
//   LCD_RD   connects to Analog pin A0
//   LCD_WR   connects to Analog pin A1
//   LCD_RS   connects to Analog pin A2
//   LCD_CS   connects to Analog pin A3
//   LCD_RST  connects to Analog pin A4
//   LCD_D0   connects to digital pin 8
//   LCD_D1   connects to digital pin 9
//   LCD_D2   connects to digital pin 2
//   LCD_D3   connects to digital pin 3
//   LCD_D4   connects to digital pin 4
//   LCD_D5   connects to digital pin 5
//   LCD_D6   connects to digital pin 6
//   LCD_D7   connects to digital pin 7
//==========================================================





// These are important pins (for TFT LCD screen)
//----------------------------------------------------------
#define LCD_RESET A4
#define LCD_CS A3
#define LCD_CD A2
#define LCD_WR A1
#define LCD_RD A0
//Pins 2-9 are also occupied by LCD screen
//----------------------------------------------------------



// Assign human-readable names to some common 16-bit color values:
#define BLACK   0x0000
#define BLUE    0x001F
#define RED     0xF800
#define GREEN   0x03E0
#define CYAN    0x07FF
#define MAGENTA 0xF81F
#define YELLOW  0xFFE0
#define WHITE   0xFFFF
#define ORANGE  0xF980



// Defining input buttons for selection:
#define BUTTON A5
#define CONFIRM 0 // may need to rewire some LCD screen wries, 0 is a place holder since serial monitor is used

// Defining other constants
#define TRANSMIT_TIME 5000 // in ms
#define IDLE_TIME 30000 // in ms
#define ON 0 // default on state

// Defining device ID
#define DEVICE_ID 0


// defining some bitmaps
// 'firstaid', 100x100px
const unsigned char medical [] PROGMEM = {
  0x00, 0x00, 0x00, 0x00, 0x00, 0x00, 0x00, 0x00, 0x00, 0x00, 0x00, 0x00, 0x00, 0x00, 0x00, 0x00,
  0x00, 0x00, 0x7f, 0xff, 0xe0, 0x00, 0x00, 0x00, 0x00, 0x00, 0x00, 0x00, 0x00, 0x00, 0x07, 0xff,
  0xff, 0xfe, 0x00, 0x00, 0x00, 0x00, 0x00, 0x00, 0x00, 0x00, 0x00, 0x3f, 0xff, 0xff, 0xff, 0xc0,
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  0x00, 0x00, 0x00, 0x00
};

const byte shelter[] PROGMEM = {// 'shelter', 100x100px
  0x00, 0x00, 0x00, 0x00, 0x00, 0x00, 0x00, 0x00, 0x00, 0x00, 0x00, 0x00, 0x00, 0x00, 0x00, 0x00,
  0x00, 0x00, 0x7f, 0xff, 0xe0, 0x00, 0x00, 0x00, 0x00, 0x00, 0x00, 0x00, 0x00, 0x00, 0x07, 0xff,
  0xff, 0xfe, 0x00, 0x00, 0x00, 0x00, 0x00, 0x00, 0x00, 0x00, 0x00, 0x3f, 0xff, 0xff, 0xff, 0xc0,
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  0x00, 0x00, 0x00, 0x00
};

// 'ration', 100x100px
const unsigned char ration [] PROGMEM = {
  0x00, 0x00, 0x00, 0x00, 0x00, 0x00, 0x00, 0x00, 0x00, 0x00, 0x00, 0x00, 0x00, 0x00, 0x00, 0x00,
  0x00, 0x00, 0x7f, 0xff, 0xe0, 0x00, 0x00, 0x00, 0x00, 0x00, 0x00, 0x00, 0x00, 0x00, 0x07, 0xff,
  0xff, 0xfe, 0x00, 0x00, 0x00, 0x00, 0x00, 0x00, 0x00, 0x00, 0x00, 0x3f, 0xff, 0xff, 0xff, 0xc0,
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  0x00, 0x00, 0x00, 0x00
};

// 'transparent_sq', 104x104px
const unsigned char transSq [] PROGMEM = {
  0xff, 0xff, 0xff, 0xff, 0xff, 0xff, 0xff, 0xff, 0xff, 0xff, 0xff, 0xff, 0xff, 0xff, 0xff, 0xff,
  0xff, 0xff, 0xff, 0xff, 0xff, 0xff, 0xff, 0xff, 0xff, 0xff, 0xff, 0xfc, 0x00, 0x00, 0x00, 0x00,
  0x00, 0x00, 0x00, 0x00, 0x00, 0x3f, 0xff, 0xff, 0xe0, 0x00, 0x00, 0x00, 0x00, 0x00, 0x00, 0x00,
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  0xff, 0xff, 0xff, 0xff, 0xff, 0xff, 0xff, 0xff
};





//==============================================================================================
//Prototype functions
//==============================================================================================
void normalDisplay(void);
void optionSelectionUI(void);
void gpsGetCoordinates(void);
String encodeMessage(String);
String parseMessage(String,byte);
// Some functions for optionSelectUI
void selectShelter(void);
void deselectShelter(void);
void selectRation(void);
void deselectRation(void);
void selectMedical(void);
void deselectMedical(void);
// SOme functions to call and read lopy
void callLopy(unsigned long wakeTime);
void readLopy(void);
//==============================================================================================




//==============================================================================================
// Global variables
//==============================================================================================

MCUFRIEND_kbv tft;
byte Message = 11, c_Message = 11;
String broadcastMessage = "", requestStatus = "";
SoftwareSerial gpsSerial (13, 12); //13 to GPS TX, 12 tp GPS RX
SoftwareSerial lopy (11, 10);       //11 to lopy TX, 10 to lopy RX //this is temporary as well, high chance using hardware serial
TinyGPS gps;
String msgStatus = "0";
float flat = 0;
float flon = 0;
unsigned long fix_age = 1, time, date; // returns +- latitude/longitude in degrees
unsigned long screenOn = millis();
byte screenUp = 0;

//==============================================================================================

void setup() {

  Serial.begin(9600);
  Serial.println("SudoX rescue handset ready!");
  gpsSerial.begin(9600);
  lopy.begin(9600);

  //gpsSerial.print("!UBX CFG-GPS0 1"); // send to low power mode
  Serial.print("Sizeof(gpsobject) = ");
  Serial.println(sizeof(TinyGPS));
  Serial.println();

  tft.reset();
  uint16_t identifier = tft.readID();
  tft.begin(identifier);
  tft.fillScreen(BLACK);
  tft.setRotation(3);
  tft.setCursor(5, 25);
  tft.setTextColor(WHITE);
  tft.setTextSize(4);
  // Write HELP IS HERE!
  tft.println("HELP IS HERE!");
  normalDisplay();

  //Listening to LoPy, code here must change!
  // first edits done on 30/12/2018
  lopy.write("OK");
  lopy.listen();
  while (!lopy.available());
  while (lopy.available()) {
    Message = parseMessage(lopy.readString(),0).toInt();
  }

  pinMode(BUTTON, INPUT); // reading different voltage levels as left and right
  pinMode(CONFIRM, INPUT); // sending this message to lopy
  tft.setTextSize(2);


   if (Message == 0) {
    selectShelter();
  }
  else if (Message == 1) {
    selectRation();
  }
  else if (Message == 2) {
    selectMedical();
  }
  tft.setCursor(80, 180);
  tft.print("Message:");
  tft.print(Message);
}

void loop() {
  if ((millis() % IDLE_TIME) == 0) {
    gpsGetCoordinates();
    screenOn = screenOn/IDLE_TIME;
    callLopy();
    readLopy();
  }
  optionSelectionUI();
}

void normalDisplay() {
  // We draw 3 circles horizontal in the screen with the icons
  // size R = 51, distance betwen each circle is 10
  // 1st circle(shelter)
  //tft.drawRoundRect(2, tft.height() / 2 - 51, 102, 102, 51, BLUE);
  tft.fillRoundRect(2, tft.height() / 2 - 51, 102, 102, 51, BLUE);
  tft.drawBitmap(3, tft.height() / 2 - 50 , shelter, 100, 100, WHITE);
  //2nd circle(ration)
  //tft.drawRoundRect(100 + 8, tft.height() / 2 - 51, 102, 102, 51, GREEN);
  tft.fillRoundRect(100 + 8, tft.height() / 2 - 51, 102, 102, 51, GREEN);
  tft.drawBitmap(100 + 9, tft.height() / 2 - 50 , ration, 100, 100, WHITE);
  //3rd round circle(medical)
  //tft.drawRoundRect(200 + 14, tft.height() / 2 - 51, 102, 102, 51, RED);
  tft.fillRoundRect(200 + 14, tft.height() / 2 - 51, 102, 102, 51, RED);
  tft.drawBitmap(200 + 15, tft.height() / 2 - 50 , medical, 100, 100, WHITE);
}

void optionSelectionUI() {

  // "pending" code: two way communication

  // left right scrolling
  if (analogRead(BUTTON) > 100) {
    screenOn = millis() - screenOn; // reset time to sleep
    if (analogRead(BUTTON) < 700) {
      tft.setCursor(90, 180);
      if (Message == 0) {
        deselectShelter();
        selectRation();
        Message = 1;
      } else if (Message == 1) {
        deselectRation();
        selectMedical();
        Message = 2;
      } else if (Message == 2) {
        //Message = selectLeft();
        deselectMedical();
        selectShelter();
        Message = 0;
      }
      tft.fillRoundRect(90, 180, 180, 60, 0, BLACK);
    } else if (analogRead(BUTTON) >= 700) {
      if (Message == 0) {
        deselectShelter();
        selectMedical();
        Message = 2;
      } else if (Message == 2) {
        deselectMedical();
        selectRation();
        Message = 1;
      } else if (Message == 1) {
        deselectRation();
        selectShelter();
        Message = 0;
      }
      tft.fillRoundRect(90, 180, 180, 60, 0, BLACK);
    }
    // this part is for debugging purposes
    tft.setCursor(80, 180);
    tft.print("Message:");
    tft.print(Message);
    delay(100);
  }
  else if (digitalRead(CONFIRM)) {
    screenOn = millis()-screenOn;
    c_Message = Message;
    delay(100);
    // some code to show it has been confirmed
  }
}

void selectShelter(){
  tft.drawBitmap(2, tft.height() / 2 - 52 , transSq, 104, 104, WHITE);
}

void deselectShelter(){
  tft.drawBitmap(2, tft.height() / 2 - 52 , transSq, 104, 104, BLACK);
}

void selectRation(){
  tft.drawBitmap(108, tft.height() / 2 - 52 , transSq, 104, 104, WHITE);
}

void deselectRation(){
  tft.drawBitmap(108, tft.height() / 2 - 52 , transSq, 104, 104, BLACK);
}

void selectMedical(){
  tft.drawBitmap(213, tft.height() / 2 - 52  , transSq, 104, 104, WHITE);
}

void deselectMedical(){
  tft.drawBitmap(213, tft.height() / 2 - 52  , transSq, 104, 104, BLACK);
}

void gpsGetCoordinates() {
  // checks if gps signal is detected
  // if detected, sends signal to lopy
  // if not detected, skips transmission

  if (gpsSerial.available()) {
    gps.f_get_position(&flat, &flon, &fix_age);
    gps.get_datetime(&date, &time, &fix_age);

    // Debugging purposes
    /*Serial.print("Latitude:"); Serial.print(flat);
      Serial.print("Longitude:"); Serial.println(flon);
      Serial.print("Last Seen:"); Serial.println(fix_age);*/
  }
  else {
    // If GPS is not available, will not transmit (the code below is a place holder for debugging purposes
    /*newdata = false;
      Serial.print("Latitude:"); Serial.print(flat);
      Serial.print("Longitude:"); Serial.print(flon);
      Serial.print("Last Seen:"); Serial.println(fix_age);*/
  }
}

void callLopy() {
  lopy.println(encodeMessage());
}

void readLopy() {
  String buffer;
  while (!lopy.available());
  while (lopy.available()) {
    buffer = lopy.readString();
  }
  c_Message = parseMessage(buffer, 0).toInt();
  broadcastMessage = parseMessage(buffer, 1); 
  requestStatus = parseMessage(buffer,2); // remember to save P I C as strings!
}

// Here is the parsing of Json messages
// Format of the string from lopy to Arduino is
/*
   "Selection,broadcast"(this is what the arduino sees)
   "Device ID, dd/mm/yy hh:mm,latitude, longitude, resource
*/

String encodeMessage() {
  // "Device ID, dd/mm/yy hh:mm,latitude, longitude, resourceid, screenUp
  String buffer = String(DEVICE_ID) + "," + String(date) + " " + String(time) + "," + String(flat) + "," + String(flon) + "," + String(c_Message) + "," + String(screenOn);
  Serial.println(buffer);
  return buffer;
}

String parseMessage(String rawMessage, byte index) {
  // "Selection,broadcast,status"
  byte commaNum = 0, startNum = 0;
  String buffer;
  for (int i = 0; i < index + 1; i++) {
    commaNum = rawMessage.indexOf(",", startNum);
    buffer = rawMessage.substring(startNum, commaNum);
    startNum = commaNum;
  }
  return buffer;
}
