#include <MCUFRIEND_kbv.h>
#include <Adafruit_GFX.h>    // Core graphics library
#include <avr/pgmspace.h>
#include <SoftwareSerial.h>
#include <TinyGPS.h>

//========================================================
// Reference for  s u d o
//========================================================
// wiring with UNO or Mega2560:
//--------------POWER Pins--------------------------------
//   5V  connects to DC 5V
//   GND connects to Ground
//   3V3 do not need to connect(NC)
//--------------LCD Display Pins--------------------------
//   LCD_RD   connects to Analog pin A0
//   LCD_WR   connects to Analog pin A1
//   LCD_RS   connects to Analog pin A2
//   LCD_CS   connects to Analog pin A3
//   LCD_RST  connects to Analog pin A4
//   LCD_D0   connects to digital pin 8
//   LCD_D1   connects to digital pin 9
//   LCD_D2   connects to digital pin 2
//   LCD_D3   connects to digital pin 3
//   LCD_D4   connects to digital pin 4
//   LCD_D5   connects to digital pin 5
//   LCD_D6   connects to digital pin 6
//   LCD_D7   connects to digital pin 7
//--------------SD-card fuction Pins ----------------------
//This Connection Only for UNO, Do not support Mega2560
//because they use different Hardware-SPI Pins
//SD_SS    connects to digital pin 10
//SD_DI    connects to digital pin 11
//SD_DO    connects to digital pin 12
//SD_SCK   connects to digital pin 13
//==========================================================





// These are important pins
//----------------------------------------------------------
#define LCD_RESET A4
#define LCD_CS A3
#define LCD_CD A2
#define LCD_WR A1
#define LCD_RD A0
//----------------------------------------------------------



// Assign human-readable names to some common 16-bit color values:
#define BLACK   0x0000
#define BLUE    0x001F
#define RED     0xF800
#define GREEN   0x03E0
#define CYAN    0x07FF
#define MAGENTA 0xF81F
#define YELLOW  0xFFE0
#define WHITE   0xFFFF
#define ORANGE  0xF980



// Defining input buttons for selection:
#define BUTTON A5

// Defining other constants
#define TRANSMIT_TIME 5000 // in ms


// defining some bitmaps
// 'firstaid', 100x100px
const unsigned char medical [] PROGMEM = {
  0x00, 0x00, 0x00, 0x00, 0x00, 0x00, 0x00, 0x00, 0x00, 0x00, 0x00, 0x00, 0x00, 0x00, 0x00, 0x00,
  0x00, 0x00, 0x7f, 0xff, 0xe0, 0x00, 0x00, 0x00, 0x00, 0x00, 0x00, 0x00, 0x00, 0x00, 0x07, 0xff,
  0xff, 0xfe, 0x00, 0x00, 0x00, 0x00, 0x00, 0x00, 0x00, 0x00, 0x00, 0x3f, 0xff, 0xff, 0xff, 0xc0,
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  0x00, 0x00, 0x00, 0x00
};

const byte shelter[] PROGMEM = {// 'shelter', 100x100px
  0x00, 0x00, 0x00, 0x00, 0x00, 0x00, 0x00, 0x00, 0x00, 0x00, 0x00, 0x00, 0x00, 0x00, 0x00, 0x00,
  0x00, 0x00, 0x7f, 0xff, 0xe0, 0x00, 0x00, 0x00, 0x00, 0x00, 0x00, 0x00, 0x00, 0x00, 0x07, 0xff,
  0xff, 0xfe, 0x00, 0x00, 0x00, 0x00, 0x00, 0x00, 0x00, 0x00, 0x00, 0x3f, 0xff, 0xff, 0xff, 0xc0,
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  0x00, 0x00, 0x00, 0x00
};

// 'food', 100x100px
const unsigned char food [] PROGMEM = {
  0x00, 0x00, 0x00, 0x00, 0x00, 0x00, 0x00, 0x00, 0x00, 0x00, 0x00, 0x00, 0x00, 0x00, 0x00, 0x00,
  0x00, 0x00, 0x7f, 0xff, 0xe0, 0x00, 0x00, 0x00, 0x00, 0x00, 0x00, 0x00, 0x00, 0x00, 0x07, 0xff,
  0xff, 0xfe, 0x00, 0x00, 0x00, 0x00, 0x00, 0x00, 0x00, 0x00, 0x00, 0x3f, 0xff, 0xff, 0xff, 0xc0,
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  0x00, 0x00, 0x00, 0x00
};

// 'transparent_sq', 104x104px
const unsigned char transSq [] PROGMEM = {
  0xff, 0xff, 0xff, 0xff, 0xff, 0xff, 0xff, 0xff, 0xff, 0xff, 0xff, 0xff, 0xff, 0xff, 0xff, 0xff,
  0xff, 0xff, 0xff, 0xff, 0xff, 0xff, 0xff, 0xff, 0xff, 0xff, 0xff, 0xfc, 0x00, 0x00, 0x00, 0x00,
  0x00, 0x00, 0x00, 0x00, 0x00, 0x3f, 0xff, 0xff, 0xe0, 0x00, 0x00, 0x00, 0x00, 0x00, 0x00, 0x00,
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  0xff, 0xff, 0xff, 0xff, 0xff, 0xff, 0xff, 0xff
};





//==============================================================================================
//Prototype functions
//==============================================================================================
void normalDisplay(void);
void optionSelectionUI(void);
bool gpsDetect(void);
//==============================================================================================




//==============================================================================================
// Global variables
//==============================================================================================

MCUFRIEND_kbv tft;
String Message;
SoftwareSerial gpsSerial (A5, A4); //A5 to GPS TX, A4 tp GPS RX
TinyGPS gps;
bool newdata = false;
unsigned long startTime = millis();
float flat, flon;
unsigned long fix_age = 1; // returns +- latitude/longitude in degrees
unsigned int count=0;

//==============================================================================================

void setup() {
  Serial.begin(9600);
  Serial.println("SudoX rescue handset ready!");
  gpsSerial.begin(9600);
  gpsSerial.print("!UBX CFG-GPS0 1"); // send to low power mode
  Serial.print("Sizeof(gpsobject) = ");
  Serial.println(sizeof(TinyGPS));
  Serial.println();
  tft.reset();
  uint16_t identifier = tft.readID();
  tft.begin(identifier);
  tft.fillScreen(BLACK);
  tft.setRotation(3);
  unsigned long start = micros();
  tft.setCursor(5, 25);
  tft.setTextColor(WHITE);
  tft.setTextSize(4);
  // Write Rescue is on the way
  tft.println("HELP IS HERE!");
  Message = "Shelter";
  //pinMode(RIGHT, INPUT);
  //pinMode(LEFT, INPUT);
  pinMode(BUTTON, INPUT);
  tft.setTextSize(2);
  normalDisplay();
  tft.drawBitmap(2, tft.height() / 2 - 52 , transSq, 104, 104, WHITE);
  tft.setCursor(80, 180);
  tft.print("Message:");
  tft.print(Message);
}

void loop() {
  //optionSelectionUI();
  if (!gpsDetect())count++;
  Serial.print("Missed Transmission Cycle: ");Serial.print(count);
}

void normalDisplay() {
  // We draw 3 circles horizontal in the screen with the icons
  // size R = 51, distance betwen each circle is 10
  // 1st circle + put my face
  tft.drawRoundRect(2, tft.height() / 2 - 51, 102, 102, 51, BLUE);
  tft.fillRoundRect(2, tft.height() / 2 - 51, 102, 102, 51, BLUE);
  tft.drawBitmap(3, tft.height() / 2 - 50 , shelter, 100, 100, WHITE);
  //2nd circle
  tft.drawRoundRect(100 + 8, tft.height() / 2 - 51, 102, 102, 51, GREEN);
  tft.fillRoundRect(100 + 8, tft.height() / 2 - 51, 102, 102, 51, GREEN);
  tft.drawBitmap(100 + 9, tft.height() / 2 - 50 , food, 100, 100, WHITE);
  //3rd round circle
  tft.drawRoundRect(200 + 14, tft.height() / 2 - 51, 102, 102, 51, RED);
  tft.fillRoundRect(200 + 14, tft.height() / 2 - 51, 102, 102, 51, RED);
  tft.drawBitmap(200 + 15, tft.height() / 2 - 50 , medical, 100, 100, WHITE);

}

void optionSelectionUI() {
  if (analogRead(BUTTON) > 100) {
    if (analogRead(BUTTON) < 700) {
      tft.setCursor(90, 180);
      if (Message == "Shelter") {
        tft.drawBitmap(2, tft.height() / 2 - 52 , transSq, 104, 104, BLACK);
        tft.drawBitmap(100 + 8, tft.height() / 2 - 52 , transSq, 104, 104, WHITE);
        Message = "Food";
      } else if (Message == "Food") {
        tft.drawBitmap(100 + 8, tft.height() / 2 - 52  , transSq, 104, 104, BLACK);
        tft.drawBitmap(200 + 13, tft.height() / 2 - 52  , transSq, 104, 104, WHITE);
        Message = "Medical";
      } else if (Message == "Medical") {
        //Message = selectLeft();
        tft.drawBitmap(200 + 13, tft.height() / 2 - 52  , transSq, 104, 104, BLACK);
        tft.drawBitmap(2, tft.height() / 2 - 52 , transSq, 104, 104, WHITE);
        Message = "Shelter";
      }
      tft.fillRoundRect(90, 180, 180, 60, 0, BLACK);
    } else if (analogRead(BUTTON) >= 700) {
      if (Message == "Shelter") {
        tft.drawBitmap(2, tft.height() / 2 - 52 , transSq, 104, 104, BLACK);
        tft.drawBitmap(200 + 13, tft.height() / 2 - 52  , transSq, 104, 104, WHITE);
        Message = "Medical";
      } else if (Message == "Medical") {
        tft.drawBitmap(200 + 13, tft.height() / 2 - 52  , transSq, 104, 104, BLACK);
        tft.drawBitmap(100 + 8, tft.height() / 2 - 52 , transSq, 104, 104, WHITE);
        Message = "Food";
      } else if (Message == "Food") {
        tft.drawBitmap(100 + 8, tft.height() / 2 - 52  , transSq, 104, 104, BLACK);
        tft.drawBitmap(2, tft.height() / 2 - 52 , transSq, 104, 104, WHITE);
        Message = "Shelter";
      }
      //tft.drawRoundRect(80,180,180,60,0,BLACK);
      tft.fillRoundRect(90, 180, 180, 60, 0, BLACK);
    }

    tft.setCursor(80, 180);
    tft.print("Message:");
    tft.print(Message);
    delay(100);
  }
}

bool gpsDetect() {
  // checks if gps signal is detected every 5 seconds,
  // if detected, sends signal to loPy
  // if not detected, skips transmission
  // Note: best if there's a way to wake loPy up through interrupt pin
  //       Arduino doesn't have any extra pins, but could reuse button pins
  //       please note buttons pins one is 5V one is 2.5V, loPy doesn't support 5V
  //
  // return false for each missed counts,
  // detected/not reached transmission cycle will default to true

  if (gpsSerial.available() && (millis() - startTime > TRANSMIT_TIME)) {
    gps.f_get_position(&flat, &flon, &fix_age);
    if (fix_age == TinyGPS::GPS_INVALID_AGE) {
      Serial.println("Critical: location not fixed!");
      newdata = false;
    }
    else if (fix_age > 5000) {
      Serial.println("Warning: no GPS signal!");
      newdata = false;
    }
    else {
      Serial.println("GPS detected");
      newdata = true;
    }

    Serial.print("Latitude:"); Serial.print(flat);
    Serial.print("Longitude:"); Serial.print(flon);
    Serial.print("Last Seen:"); Serial.println(fix_age);
  }
  else newdata = false;
  if (newdata) {
    //transmit code to loPy (to James)
  }
  else if (!newdata && (millis() - startTime > TRANSMIT_TIME)) {
    return false;
  }
  return true;
}

